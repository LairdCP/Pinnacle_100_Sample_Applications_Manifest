## west.yml
```yaml
manifest:
  remotes:
    - name: CanvasDM
      url-base: https://github.com/CanvasDM
    - name: LairdCP
      url-base: https://github.com/LairdCP
    - name: Nordic
      url-base: https://github.com/nrfconnect

  # Please add items below based on alphabetical order.
  # These dependencies may need updating if new features are added to the firmware.
  # Please add items below based on alphabetical order.
  # These dependencies may need updating if new features are added to the firmware.
  projects:
    - name: Pinnacle_100_Sample_Applications
      revision: 0d02e2be3673d7b22cbe358cf9958b54451f9b2a
      remote: LairdCP
    - name: sdk-nrf
      path: nrf
      revision: v2.4.1
      remote: Nordic
      import:
        # Please keep this list sorted alphabetically.
        name-blocklist:
          - Alexa-Gadgets-Embedded-Sample-Code
          - canopennode
          - cirrus
          - civetweb
          - connectedhomeip
          - find-my
          - hal_st
          - homekit
          - loramac-node
          - lvgl
          - matter
          - mbed-cloud-client
          - nrf-802154
          - openthread
          - sdk-lc3
          - zephyr
    - name: zephyr
      revision: ef63a2df1b3683e13d5b08a0fa68162825abcc34
      remote: LairdCP
      import:
        # Please keep this list sorted alphabetically.
        name-allowlist:
          - cmsis
          - fatfs
          - hal_nordic
          - libmetal
          - littlefs
          - mbedtls
          - mcumgr
          - mipi-sys-t
          - net-tools
          - nrf_hw_models
          - open-amp
          - openthread
          - segger
          - tinycrypt
          - zcbor
    - name: zephyr_lib
      path: modules/lib/laird_connect/zephyr_lib
      revision: db55ee78bb9ef9b7bc085c1ebad01046935ca92e
      remote: LairdCP
    - name: network_monitor_module
      path: modules/lib/laird_connect/network_monitor
      revision: a4ad284f9aed3c7266832c9455d010e1f952c33c
      remote: CanvasDM

  self:
    path: Pinnacle_100_Sample_Applications_public_manifest
```
